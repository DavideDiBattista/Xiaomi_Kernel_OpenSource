## sound/soc/codecs/aw882xx/Kconfig
```kconfig
config SND_SMARTPA_AW882XX
	tristate "SoC Audio for awinic aw882xxseries"
	depends on I2C


config SND_SMARTPA_AW882XX_GPIO_CONFIG
	tristate "SoC Audio for awinic aw882xxseries config reset GPIO"
	depends on I2C
```
